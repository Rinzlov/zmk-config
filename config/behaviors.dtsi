left_encoder: encoder_left {
    compatible = "alps,ec11";
    label = "LEFT_ENCODER";
    a-gpios = <&pro_micro 19 (GPIO_ACTIVE_HIGH | GPIO_PULL_UP)>;
    b-gpios = <&pro_micro 20 (GPIO_ACTIVE_HIGH | GPIO_PULL_UP)>;
    steps = <120>;
    status = "disabled";
};

right_encoder: encoder_right {
    compatible = "alps,ec11";
    label = "RIGHT_ENCODER";
    a-gpios = <&pro_micro 20 (GPIO_ACTIVE_HIGH | GPIO_PULL_UP)>;
    b-gpios = <&pro_micro 19 (GPIO_ACTIVE_HIGH | GPIO_PULL_UP)>;
    steps = <120>;
    status = "disabled";
};

sensors {
    compatible = "zmk,keymap-sensors";
    sensors = <&left_encoder &right_encoder>;
    triggers-per-rotation = <10>;
};
