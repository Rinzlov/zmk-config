/ {
    left_encoder: encoder_left {
        /delete-property/ resolution;
        steps = <72>;
        status = "okay";
    };

    right_encoder: encoder_right {
        /delete-property/ resolution;
        steps = <142>;
        status = "okay";
    };

    sensors {
        sensors = <&left_encoder &right_encoder>;
        triggers-per-rotation = <36>;
    };
};
